## config/west.yml
```yaml
manifest:
  remotes:
    - name: petejohanson
      url-base: https://github.com/zmkfirmware
  projects:
    - name: zmk
      remote: petejohanson
      revision: shields/splitkb-aurora-helix
      import: app/west.yml
  self:
    path: config
```
